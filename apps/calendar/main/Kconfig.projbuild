## apps/calendar/main/Kconfig.projbuild
```kconfig
menu "Calendar"

    config CALENDAR_ICAL_URL
        string "Google Calendar iCal URL"
        default ""
        help
            Secret iCal URL from Google Calendar settings.
            Go to: Google Calendar → Settings → [calendar] → "Secret address in iCal format"

    config CALENDAR_TIMEZONE
        string "POSIX timezone string"
        default "CET-1CEST,M3.5.0,M10.5.0/3"
        help
            POSIX TZ string for local time display. Default is Oslo (CET/CEST).

    config CALENDAR_FETCH_INTERVAL_S
        int "Calendar fetch interval (seconds)"
        default 300
        range 60 3600
        help
            How often to re-fetch the iCal feed. Default: 5 minutes.

    config CALENDAR_WEATHER_LAT
        string "Weather forecast latitude"
        default "59.9264"
        help
            Latitude for YR/met.no weather forecast.
            Default: Birkelunden, Oslo (59.9264)

    config CALENDAR_WEATHER_LON
        string "Weather forecast longitude"
        default "10.7602"
        help
            Longitude for YR/met.no weather forecast.
            Default: Birkelunden, Oslo (10.7602)

endmenu

# ─── Compatibility with shared knob_storage component ────────────────────────
# knob_storage/settings.cpp references CONFIG_RADIO_* symbols at compile time.
# We provide them here with sensible defaults so the shared component builds
# without modification for non-radio apps.

menu "Radio (compat)"

    config RADIO_WIFI_SSID
        string "WiFi SSID (compat)"
        default ""

    config RADIO_WIFI_PASSWORD
        string "WiFi password (compat)"
        default ""

    config RADIO_WIFI_MAX_RETRIES
        int "WiFi max retries (compat)"
        default 5

    config RADIO_VOLUME_DEFAULT
        int "Default volume (compat)"
        default 33

    config RADIO_SONOS_SPEAKER_IP
        string "Sonos speaker IP (compat)"
        default ""

    config RADIO_SONOS_POLL_INTERVAL_MS
        int "Sonos poll interval (compat)"
        default 2000

    config RADIO_OPENAI_API_KEY
        string "OpenAI API key (compat)"
        default ""

endmenu
```

## apps/calendar/sdkconfig.defaults.local.template
```kconfig
# Local secrets — copy to sdkconfig.defaults.local and fill in your values.
# This file is gitignored. Do not commit real credentials.

CONFIG_CALENDAR_WIFI_SSID="your-wifi-ssid"
CONFIG_CALENDAR_WIFI_PASSWORD="your-wifi-password"
CONFIG_CALENDAR_ICAL_URL=""
```

## apps/radio/main/Kconfig.projbuild
```kconfig
menu "Sonos Radio"

    config RADIO_WIFI_SSID
        string "Default WiFi SSID"
        default ""
        help
            Fallback SSID if nothing stored in NVS.

    config RADIO_WIFI_PASSWORD
        string "Default WiFi Password"
        default ""
        help
            Fallback password if nothing stored in NVS.

    config RADIO_WIFI_MAX_RETRIES
        int "WiFi connection retries before backoff"
        default 5
        range 1 20

    config RADIO_SONOS_SPEAKER_IP
        string "Sonos speaker IP address"
        default "192.168.1.100"
        help
            Hardcoded speaker IP for MVP. Will be replaced by SSDP discovery.

    config RADIO_SONOS_POLL_INTERVAL_MS
        int "Sonos state poll interval (ms)"
        default 2000
        range 1000 30000

    config RADIO_VOLUME_DEFAULT
        int "Default volume (0-100)"
        default 33
        range 0 100

    config RADIO_TIMEZONE
        string "POSIX timezone string"
        default "CET-1CEST,M3.5.0,M10.5.0/3"
        help
            POSIX TZ string for local time display. Default is Oslo (CET/CEST).
            See: https://www.gnu.org/software/libc/manual/html_node/TZ-Variable.html
            Examples:
              US Eastern:  EST5EDT,M3.2.0,M11.1.0
              US Pacific:  PST8PDT,M3.2.0,M11.1.0
              UK:          GMT0BST,M3.5.0/1,M10.5.0
              Japan:       JST-9

    config RADIO_OPENAI_API_KEY
        string "OpenAI API key for voice mode"
        default ""
        help
            API key for OpenAI Realtime API. Required for voice assistant.
            Set via .env file on SD card (OPENAI_API_KEY=sk-proj-...) or
            pass directly here for development.

endmenu
```

## apps/template/main/Kconfig.projbuild
```kconfig
menu "Knob App Configuration"

    config RADIO_WIFI_SSID
        string "WiFi SSID"
        default ""

    config RADIO_WIFI_PASSWORD
        string "WiFi Password"
        default ""

    config RADIO_WIFI_MAX_RETRIES
        int "WiFi Max Retries"
        default 0
        help
            0 = infinite retries

    config RADIO_TIMEZONE
        string "Timezone (POSIX TZ)"
        default "CET-1CEST,M3.5.0,M10.5.0/3"

endmenu
```

## apps/template/sdkconfig.defaults.local.template
```kconfig
# Local secrets — copy to sdkconfig.defaults.local and fill in values
# This file is gitignored. Never commit real credentials.

CONFIG_RADIO_WIFI_SSID="your_wifi_ssid"
CONFIG_RADIO_WIFI_PASSWORD="your_wifi_password"
```

## main/Kconfig.projbuild
```kconfig
menu "Sonos Radio"

    config RADIO_WIFI_SSID
        string "Default WiFi SSID"
        default ""
        help
            Fallback SSID if nothing stored in NVS.

    config RADIO_WIFI_PASSWORD
        string "Default WiFi Password"
        default ""
        help
            Fallback password if nothing stored in NVS.

    config RADIO_WIFI_MAX_RETRIES
        int "WiFi connection retries before backoff"
        default 5
        range 1 20

    config RADIO_SONOS_SPEAKER_IP
        string "Sonos speaker IP address"
        default "192.168.1.100"
        help
            Hardcoded speaker IP for MVP. Will be replaced by SSDP discovery.

    config RADIO_SONOS_POLL_INTERVAL_MS
        int "Sonos state poll interval (ms)"
        default 5000
        range 1000 30000

    config RADIO_VOLUME_DEFAULT
        int "Default volume (0-100)"
        default 20
        range 0 100

endmenu
```

## sdkconfig.defaults
```kconfig
# Target
CONFIG_IDF_TARGET="esp32s3"

# Flash
CONFIG_ESPTOOLPY_FLASHSIZE_16MB=y
CONFIG_ESPTOOLPY_FLASHMODE_QIO=y
CONFIG_ESPTOOLPY_FLASHFREQ_80M=y

# Custom partition table (16MB flash with SPIFFS storage)
CONFIG_PARTITION_TABLE_CUSTOM=y
CONFIG_PARTITION_TABLE_CUSTOM_FILENAME="partitions.csv"

# PSRAM (Octal, 8MB)
CONFIG_SPIRAM=y
CONFIG_SPIRAM_MODE_OCT=y
CONFIG_SPIRAM_SPEED_80M=y
CONFIG_SPIRAM_BOOT_INIT=y
CONFIG_SPIRAM_ALLOW_STACK_EXTERNAL_MEMORY=y
CONFIG_SPIRAM_TRY_ALLOCATE_WIFI_LWIP=y

# FreeRTOS
CONFIG_FREERTOS_HZ=1000
CONFIG_FREERTOS_TIMER_TASK_STACK_DEPTH=4096

# WiFi — tuned buffer counts (RX_BA_WIN must be <= DYNAMIC_RX_BUFFER_NUM
# and <= 2 * STATIC_RX_BUFFER_NUM)
CONFIG_ESP_WIFI_STATIC_RX_BUFFER_NUM=10
CONFIG_ESP_WIFI_DYNAMIC_RX_BUFFER_NUM=32
CONFIG_ESP_WIFI_TX_BUFFER_TYPE=0
CONFIG_ESP_WIFI_STATIC_TX_BUFFER_NUM=8

# lwIP
CONFIG_LWIP_MAX_SOCKETS=8
CONFIG_LWIP_SO_RCVBUF=y

# HTTP client
CONFIG_ESP_HTTP_CLIENT_ENABLE_HTTPS=n

# Compiler — optimize for performance
CONFIG_COMPILER_OPTIMIZATION_PERF=y

# Log level — INFO for dev, switch to WARN for release
CONFIG_LOG_DEFAULT_LEVEL_INFO=y

# Watchdog
CONFIG_ESP_TASK_WDT_TIMEOUT_S=10

# Console via USB-UART bridge
CONFIG_ESP_CONSOLE_UART_DEFAULT=y

# LVGL filesystem (POSIX) and PNG decoder
CONFIG_LV_USE_FS_POSIX=y
CONFIG_LV_FS_POSIX_LETTER=65
CONFIG_LV_USE_LODEPNG=y
```

## sdkconfig.defaults.esp32s3
```kconfig
# Target-specific overrides for ESP32-S3
# ESP-IDF merges this ON TOP of sdkconfig.defaults, giving it higher priority.
# This ensures Kconfig choice blocks resolve correctly even if the component
# manager's Kconfig resolution resets them.

# LVGL memory: force clib malloc (Kconfig choice — needs explicit unset)
# Without this, LVGL uses its built-in 64KB TLSF pool instead of PSRAM.
# CONFIG_LV_USE_BUILTIN_MALLOC is not set
CONFIG_LV_USE_CLIB_MALLOC=y
# CONFIG_LV_USE_BUILTIN_STRING is not set
CONFIG_LV_USE_CLIB_STRING=y
```

## sdkconfig.defaults.local.template
```kconfig
# Local secrets — copy to sdkconfig.defaults.local and fill in your values.
# This file is gitignored. Do not commit real credentials.

CONFIG_RADIO_WIFI_SSID="your-wifi-ssid"
CONFIG_RADIO_WIFI_PASSWORD="your-wifi-password"
CONFIG_RADIO_SONOS_SPEAKER_IP="192.168.1.100"
CONFIG_RADIO_OPENAI_API_KEY=""
```
